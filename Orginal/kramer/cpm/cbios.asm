	;PN	CB
	
	cpu	z80

	;TITL	"CBIOS Y23VO"

;DEFINITION VON KONSTANTEN

CFDC: 	EQU	7CH		;STEUERUNG FDC
DFDC: 	EQU	7DH		;DATEN FDC
TC: 	EQU	78H		;TERMINAL COUNT (ENDE-IMPULS)
PIOAD:	EQU	0FCH
NDISK:	EQU	2		;ANZAHL LAUFWERKE,1 IM RAM SIMULIERT
CR:	EQU	0DH
LF:	EQU	0AH
ROM:	EQU	0E200H		;60K RAM
BDOS:	EQU	ROM-0E00H
CCP:	EQU	ROM-1600H
RDSK:	EQU	7000H		;IM RAM SIMULIERTE FLOPPY
MCSTS:	EQU	0F003H
CIO:	EQU	0F13CH
MCO:	EQU	0F009H
MWO:	EQU	0F00FH
MRI:	EQU	0F012H
RESTR:	EQU	0F400H		;RESTART MONITOR
ZS:	EQU	0F089H		;STRING-AUSGABE
STR:	EQU	0F128H

	ORG	ROM

	JP	BOOT 
WBOTE:	JP     WBOOT
	JP     MCSTS
	JP     CIO  
	JP     MCO  
	JP     DRUCK
	JP     MWO  
	JP     MRI  
	JP     HOME 
	JP     SDISK
	JP     STRCK
	JP     SSEC 
	JP     SDMA 
	JP     READ 
	JP     WRITE
	JP     LSTS 		;LISTER STATUS
	JP     STRAN		;SECTOR TRANSFORMATION
;-----------------------------------------------------------
;KOPF AUF SPUR NULL STELLEN
HOME:	LD	BC,0
	JR	STRCK
;LAUFWERK AUSWAEHLEN
;IN:C LAUFWERK (A ODER B)
;OUT:HL DPH-VEKTOR
SDISK:	LD 	HL,0		;FEHLER
	PUSH	BC
	LD	B,0
	LD	A,C
	CP	NDISK-1
DISKS:	EQU $-1
	JP	NC,RESTR	;FEHLER
	LD	L,C
	LD	H,B
	ADD	HL,HL
	ADD	HL,HL
	ADD	HL,HL
	ADD	HL,HL		;*16
	LD	DE,DPBAS	;DPH-VECTOR 1.LW
	ADD	HL,DE
	LD	(4),A
	POP	BC
	RET
LSTS:	RET			;LISTER STATUS
STRAN:	EQU	$		;SECTOR TRANSFOR.
;IN: BC LOG. SECTOR
;    DE TABELLE
	LD	B,0
	LD 	A,D		;DE=0->KEINE TRANSF.
	OR	A
	JR	NZ,STRN1
	LD	H,B
	LD	L,C
	INC	HL
	RET
STRN1:	EX	DE,HL
	ADD	HL,BC
	LD	A,(HL)		;NEUE NR.
	LD	(SEC1),A
	LD	L,A
	RET
;SECTOR EINSTELLEN
;IN: C SECTOR
;OUT: (SEC1) =C
SSEC:	EQU	$
	LD	HL,SEC1
 	LD	(HL),C
	RET
;SPUR ANWAEHLEN
;IN: C SPUR
;OUT (TRACK)=C
STRCK:	EQU	$
	LD	HL,TRACK
	LD	(HL),C
	RET
;DMA SETZEN
;IN: BC DMA
SDMA:	LD	(DMA),BC
	RET
;-----------------------------------------------------------
;CCP UND BDOS VON DEN ERSTEN SPUREN DER DISKETTE LADEN
MSGS	DB	0AH
	DB	0DH
	DB	"Y23VO 56K CP/M 2.2"
	DB	0DH
	DB	0AH
	DB	"RAMDISK ? (Y)"
	DB	0DH
	DB	0AH
	DB	0
BOOT:	EQU	$
	LD	A,0C3H
	LD	(0),A
	LD	HL,WBOTE
	LD	(1),HL
	LD	(5),A
	LD	HL,BDOS+6
	LD	(6),HL
	LD	(38H),A		;HALTEPUNKT VORBEREITEN
	LD	HL,RESTR
	LD	(39H),HL
	LD	HL,MSGS
	CALL	STR
	CALL	CIO
	CP	'Y'
	CALL	Z,IRDSK		;RAMDISK ERLAUBEN
	XOR	A
	LD	(3),A		;IOBYTE
	LD	(4),A
WBOOT:	EQU	$		;LESEN DER SYSTEMSEKTOREN
	LD	SP,80H
	CALL	INIFD		;INITIALISIERUNG FLOPPY-CONTROLLER
	LD	C,0		;LAUFWERK
	CALL	SDISK
	LD	B,2CH		;SECTORZAEHLER
	LD	C,0		;SPUR-NR.
	CALL	STRCK
	LD	D,1		;SECTOR
	LD	HL,CCP		;LADEZIEL
LOAD1:	PUSH	BC		;NAECHSTEN SECTOR
	PUSH	DE
	PUSH	HL
	LD	C,D
	CALL	SSEC		;NEUEN SECT.ANWAEHLEN
	POP	BC		;BC=LADEADRESSE
	PUSH	BC		;LADEADR RETTEN
	CALL	SDMA
	CALL	RFLOP		;SYSTEM RAUFSCHREIBEN: WFLOP EINSETZEN
	CP	0		;FEHLER?
	CALL	NZ,RESTR	;JA
	POP	HL
	LD	DE,128
	ADD	HL,DE		;LADEADR.ERHOEHEN
	POP	DE
	POP	BC
	DEC	B		;SEKTORZAHL - 1
	JR	Z,GOCPM
	INC	D		;NAECHSTEN SECT.
	LD	A,D
	CP	21H		;LETZTER?
	JR	C,LOAD1
	LD	D,1		;1.SECT.NAECHST.SPUR
	INC	C
	PUSH	BC
	PUSH	DE
	PUSH	HL
	CALL	STRCK
	POP	HL
	POP	DE
	POP	BC
	JR	LOAD1
;-----------------------------------------------------------
IRDSK:  LD	HL,0E200H	;RAMDISK INITIALISIEREN
	LD	DE,RDSK		;RAM-DISK
	LD	BC,51
	LDIR
	LD	HL,7003H	;SPRUNG ZUM CCP
	LD	(1),HL
	LD	A,2
	LD	(DISKS),A
	LD	HL,6206H	;BDOS-SPRUNG
	LD	(6),HL
	LD	A,0C3H
	LD	(HL),A
	LD	HL,BDOS+6
	LD	(6207H),HL
	RET
;-----------------------------------------------------------
GOCPM:	LD	BC,80H
	CALL	SDMA
	LD	A,(4)		;AKTUELLES LAUFWERK HOLEN
	LD	C,A
	JP	CCP
;-----------------------------------------------------------
WRITE:	LD	A,(4)
	OR	A
	JR	Z,WFLOP
	CALL	WRDSK		;RAM-DISK
	RET
READ:	LD	A,(4)
	OR	A
	JR	Z,RFLOP
	CALL	RRDSK		;RAM-DISK
	RET
;-----------------------------------------------------------
;FLOPPY LESEN MIT SEKTORAUFLOESUNG
;IN: SEC1,TRACK,DMA V. BDOS
;OUT: DMA/BDOS=1 /2ZDMA/FLOPPY
RFLOP:	PUSH	HL
	PUSH	DE
	PUSH	BC
;VERGLEICH OB AUS PUFFER GELESEN WERDEN KANN
	LD	A,46H		;LETZTE OPERATION LESEN ?
	LD	HL,CTAB
	CP	(HL)
	JR	NZ,RFLP
	INC	HL
	LD	DE,RESLT	;GLEICHES LAUFWERK ?
	LD	A,(DE)
	AND	3
	CP	(HL)
	JR	NZ,RFLP
	INC	HL		;GLEICHE SPUR ?
	INC	DE
	INC	DE
	INC	DE
	LD	A,(DE)
	CP	(HL)
	JR	NZ,RFLP
	INC	HL		;KOPF ?
	INC	DE
	LD	A,(DE)
	CP	(HL)
	JR	NZ,RFLP
	INC	HL
	LD	A,(SEC1)	;HOSTSECTOR=BDOS/2
	RRA
	JR	C,RFLP		;UNGERADE
	CP	(HL)
	JR	NZ,RFLP
;GLEICH, ALSO PUFFER LESEN, NICHT LAUFWERK
	LD	HL,FDMA+80H	;QUELLE
	LD	DE,(DMA)	;ZIEL
	LD	BC,80H		;ANZAHL BYTES
	LDIR			;UEBERTRAGEN
	POP	BC
	POP	DE
	POP	HL
	XOR	A
	RET
RFLP:	CALL	TRANS		;SEKTOR LESEN + UMRECHNEN
	PUSH	AF		;FEHLER R8272
	LD	HL,FDMA
	BIT	1,B
	JR	NZ,B2
	LD	HL, FDMA+80H	;QUELLE
B2:	LD	DE,(DMA)	;ZIEL
	LD	BC,80H
	LDIR
	POP	AF
	POP	BC
	POP	DE
	POP	HL
	RET
;-----------------------------------------------------------
;FLOPPY SCHREIBEN MIT SEKTOR EINFUEGEN
WFLOP:	PUSH	HL
	PUSH	DE
	PUSH	BC
	CALL	TRANS
	OR	A		;LESEFEHLER ?
	JR	NZ,B4
	LD	DE,FDMA
	BIT	1,B
	JR	NZ,B3
	LD	DE,FDMA+80H
B3:	LD	HL,(DMA)
	LD	BC,80H
	LDIR
	CALL	W8272
B4:	POP	BC
	POP	DE
	POP	HL
	RET
;-----------------------------------------------------------
;SEKTORTUMRECHNUNG
;IN: BDOS-SEKTOR-NR IN SEC1
;OUT:FLOPPY-SEKTOR-NR IN SECTR
;    B=0 WENN VORDERER TEIL SONST HINTEREN AUSWERTEN
;    GELESENER FLOPPY-SECTOR IN BIOS-PUFFER FDMA
TRANS:	EQU	$
	LD	B,0
	LD	A,(SEC1)	;BDOS-SEKTOR
	OR	A
	RRA			;UNGERADE?, /2
	JR	NC,B1		;NEIN ·
	ADD	A,1
	CALL	C,RESTR		;FEHLER
	LD	B,0FFH		;KENNZEICHEN
B1:	PUSH	BC
	LD	(SECTR),A
	CALL	R8272
	POP	BC		;FLAG F.UNGERADE
	RET
;-----------------------------------------------------------
;TREIBER MIT U8272
;-----------------------------------------------------------
INIFD:	LD	B,0		;INITIALISIERUNG P8272
	DJNZ	INIFD+2
	IN	A,(CFDC)
	CP	80H
	JR	Z,SPEZI
	IN	A,(DFDC)
	JR	INIFD
SPEZI:	LD	HL,STAB-1	;PARAMETER LADEN
	LD	BC,0303H	;SPECIFY-COMM 3BYTES
	CALL	WCOM1		;SCHREIBEN COMM
RECAL:	LD	BC,0207H	;SPUR 0 EINSTELLEN
	CALL	RDY		;DRIVE READY?
;-----------------------------------------------------------
SENSE:	LD	BC,0108H	;PRUEFE INTERRUPT STATUS
	CALL	WCOM
	CALL	RBYTE		;RESULT REG 0:IC1,IC2,SE,EC,NR,HD,US1,US2
	LD	B,A
	CP	80H
	CALL	NZ,RBYTE	;PCN HOLEN
	BIT	5,B		;SEEK ENDE?
	JR	Z,SENSE
	RET
STAB:	DB	1FH		;XXXX=SRT,XXXX=HUT
	DB	33H		;XXXXXXX=HLT,X=ND
;-----------------------------------------------------------
;SEKTOR SCHREIBEN/LESEN IN BETRIEBSART OHNE DMA-SCHALTKREIS
;SECTOR IN (SECTR)
;SPUR  IN (TRACK)
;AKT.LAUFWERK IN (UNIT)
;ZIEL-/QUELLADRESSE = FDMA
;KILL: A B DE HL
W8272:	DB	11H		;CODE LD DE,...
	OUTI			;WRITE DATA
	LD	A,045H		;SCHREIBKOMMANDO
	JR	RWIT
;-----------------------------------------------------------
R8272:	DB	11H		;CODE LD DE,...
	INI
	LD	A,046H		;LESEKOMMANDO
RWIT:	LD	(CTAB),A
	LD	(MODE),DE	;EINTRAGEN INI/OUTI-OP-CODE
	CALL	SEEK
RWLOP:	LD	B,10
RWOP:	PUSH	BC
	DI
	LD	B,9		;9COMMANDOBYTES
	LD	A,(CTAB)
	LD	C,A
	CALL	RDY		;AUSGABE KOMMANDO
	LD	HL,FDMA
	LD	C,DFDC
	CALL	RW
	OUT	(TC),A		;ENDE-IMPULS
	CALL	RRSLT
	POP	BC
	RET	Z		;ST0=0=KEINE FEHLER
	DJNZ	RWOP
ERR:	LD	A,1
	RET			;ERROR
;-----------------------------------------------------------
;SCHREIBEN ODER LESEN 256 BYTES
;IN: HL QUELLE ODER ZIEL
; C: DATENPORT
RW:	EQU	$
	LD	B,0		;256 BYTES
RW1:	IN	A,(CFDC)
	RLCA			;RQM-TEST
	JR	NC,RW1
	RLCA			;DIO
	RLCA			;NON-DMA
	RET	NC		;FERTIG?
MODE:	INI			;INI BEI READ DATA SONST OUTI
	JR	NZ,RW1
	RET
;-----------------------------------------------------------
SDS:	LD	BC,0204H	;PRUEFE LAUFWERK STATUS
	CALL	WCOM
	CALL	RBYTE		;STATUS REG 3:FAULT,WP,RDY,T0,TS,HD,US1,U
	RET
;-----------------------------------------------------------
SEEK:	LD	BC,030FH	;COMM SPUR EINSTELLEN
	CALL	RDY
	CALL	SENSE
SKBSY:	IN	A,(CFDC)
	AND	0FH
	JR	NZ,SKBSY
	RET
;-----------------------------------------------------------
RDY:	PUSH	BC		;LAUFWERK BETRIEBSFAEHIG ?
	CALL	SDS
	POP	BC
	BIT	5,A		;READY-BIT IN STATUSREG.3
	CALL	Z,RESTR		;FEHLER
;-----------------------------------------------------------
WCOM:	LD	HL,CTAB		;COMM IN FDC SCHREIBEN
;IN: B ANZAHL D. BYTES,C COMM
WCOM1:	CALL	DELAY
	IN	A,(CFDC)
	AND	0C0H
	CP	80H		;RQM,DIO=OUT
	JR	NZ,WCOM1
	LD	A,C
	OUT	(DFDC),A
	INC	HL
	LD	C,(HL)
	DJNZ	WCOM1
	RET
;-----------------------------------------------------------
DELAY:	PUSH	BC		;VERZOEGERUNG F.STATUSFLAG 8272
	LD	B,0FH
DEL1:	DJNZ	DEL1
	POP	BC
	RET
;-----------------------------------------------------------
RBYTE:	CALL	DELAY		;1 BYTE LESEN
	CALL	IRDY
	IN	A,(DFDC)
	RET
;-----------------------------------------------------------
RRSLT:	LD	B,6		;LESE 7 RESULT BYTES
	CALL	RBYTE
	LD	HL,RESLT
	LD	(HL),A
	AND	0C0H		;ERROR?
	LD	C,A
RESL1:	CALL	RBYTE
	INC	HL
	LD	(HL),A
	DJNZ	RESL1
	LD	A,C		;FEHLERMELDUNG STATUS REG 0
	OR	A
	RET
;-----------------------------------------------------------
IRDY:	IN	A,(CFDC)	;BEREIT F.DATENEINGABE ?
	RLCA
	JR	NC,IRDY
	AND	80H
	RLCA
	RET	C
;-----------------------------------------------------------
;FEHLERBEHANDLUNG
ERM:	DB	0FFH		;SPRUNG IN MONITOR
;-----------------------------------------------------------
;RAM-DISK
;SCHREIBEN
WRDSK:	CALL	RADR		;SEKTORADR BERECHNEN
	JR	C,BDERR		;BEREICH UEBERSCHRITTEN
	EX	DE,HL		;ZIEL-/QUELLADR. RAM-DISK
	LD	HL,(DMA)	;ZIEL-/QUELLADR. BDOS
RDSK1:	LD	BC,80H		;=1 SEKTOR
	LDIR
	XOR	A
	RET
;LESEN
RRDSK:	CALL	RADR
	JR	C,BDERR		;FEHLER
	LD	DE,(DMA)
	JR	RDSK1
BDERR:	LD	A,1		;BDOS-ERROR
	RET
;SEKTORADR. IM RAM BERECHNEN
;DE AKT. SPUR
;C AKT. SEKTOR
;B MAX. SEKTORANZAHL/DISK
RADR:	LD	D,0
	LD	A,(TRACK)
	LD	E,A
	LD	A,(SEC1)
	LD	C,A
	LD	HL,0
	LD	B,26
RADR1:	ADD	HL,DE		;UMWANDLUNG SPUREN IN SEKTOREN
	DJNZ	RADR1
	ADD	HL,BC		;AKT.SEKT.DAZU
	ADD	HL,HL		;WANDLUNG SEKTOR IN BYTES
	ADD	HL,HL
	ADD	HL,HL
	ADD	HL,HL
	ADD	HL,HL
	ADD	HL,HL
	ADD	HL,HL
	LD	BC,RDSK		;RAM-DISK-ANFANG
	ADD	HL,BC
	LD	A,0BFH		;HIGH-ADR RAM-DISK
	CP	H
	RET
;-----------------------------------------------------------
DPBAS:	EQU	$
DPHA:	DW	0
	DW	0
	DW	0
	DW	0
	DW	DIRBF
	DW	DPBF
	DW	CHK0
	DW	ALL0
DPHR:	DW	0
	DW	0
	DW	0
	DW	0
	DW	DIRBF
	DW	DPBR		;GERABTEBESCHREIBUNG
	DW	CHK1		;DIRECTORY-KONTROLLE
	DW	ALL1		;BELEGUNG DISKETTE
;DISK-PARAMETER-BLOCK RAM-DISK
DPBR:	DW	26		;SECTOREN
	DB	3		;BLOCKGROESSE 1K
	DB	7		;(SECTOREN/BLOCK)-1
	DB	00		;NICHT BENUTZT
	DW	20		;(BLOECKE/DISK)-1
	DW	31		;32 DIRECTORY-ENTR.
	DB	080H		;1 BELEGTER BLOCK DURCH DIR.
	DB	0
	DW	16		;DIR/4
	DW	0		;0SPUREN DURCH SYSTEM BELEGT
;DISK-PARAMETER-BLOCK FLOPPY 5,25 ZOLL
DPBF:	DW	20H		;20LOGISCHB=10H=16 PHYSISCHE SEKTOREN/SPUR
	DB	4		;2K-BLOECKE
	DB	15
	DB	1
	DW	73
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	DW	3		;SYSTEMSPUREN
;-----------------------------------------------------------
DRUCK:	EQU	$		;FOLGT

	include	DRUCK.ASM

;-----------------------------------------------------------

;RAM-ADRESSEN

	ORG	0F800H
CTAB:	DS 1; DB	46H	;MFM LESEN
UNIT:	DS 1; DB	0	;LAUFWERK A VOREINGESTELLT
TRACK:	DS 1; DB	0
HEAD:	DS 1; DB	0
SECTR:	DS 1; DB	1
N:	DS 1; DB	1	;N=1=256BYTES
EOT:	DS 1; DB	16	;16 SECTOREN JE SPUR
GPL:	DS 1; DB	1BH	;LUECKE
DTL:	DS 1; DB	0FFH
RESLT:	DS	7		;RESULT TAB F.FDC
DZEIL:	DS 1; DB	30	;DRUCKER 30 ZEILEN/SEITE
MERK:	DS 1; DB	0	;UMSCHALTZ. FERNSCHR.
SEC1:	DS 1; DB	1	;BDOS-SEKTOR
DMA:	DS 2; DW	80H	;BDOS-DMA
DIRBF:	DS	128		;INHALTSVERZ. DISKETTE
ALL0:	DS	31
CHK0:	DS	16
ALL1:	DS	31
CHK1:	DS	16
FDMA:	DS	256		;FLOPPY-ZWISCHENSPEICHER IM BIOS

	END
