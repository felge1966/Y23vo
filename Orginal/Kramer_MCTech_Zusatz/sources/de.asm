	;PN	DE

	TITLE	"Y23VO  DEBUGGER"

;CR:	EQU 	00DH		;WAGEN-RUECKLAUF
;LF: 	EQU 	00AH 		;ZEILENVORSCHUB
;ETX:	EQU	003H		;CONTROL/C (END OF TEXT)
;EOM: 	EQU 	0F00H 		;SYSTEMRAM-BEGINN
RAM.TLOC:	EQU	00FEBH
RAM.LLOC:	EQU	00FE5H
RAM.PLOC:	EQU	00FEAH
RAM.EXI1:	EQU	00FE4H

;OMSK:	EQU	0CFH
;IMSK:	EQU	0F3H


;RUECKSPRUNG IN DEN MONITOR
;RETTEN DER REGISTERINHALTE DES ANWENDERPROGRAMMS
;RESTR:	EQU	$
	DI
	PUSH	HL
	PUSH	DE
	PUSH	BC
	PUSH	AF
	PUSH	IX
	PUSH	IY
	LD	A,I
	PUSH	AF
	EX	AF,AF'
	EXX
	PUSH	HL
	PUSH	DE
	PUSH	BC
	PUSH	AF
	EXX
	EX	AF,AF'
;REGISTER AUF TAB.IM SYST.-RAM UMSPEICHERN
	LD	HL,24
	ADD	HL,SP
	LD	B,11
	EX	DE,HL
	LD	HL,RAM.EXI1
RST0:	DEC	HL
	LD	(HL),D
	DEC	HL
	LD	(HL),E
	POP	DE
	DJNZ	RST0
;TEST OB HALTEPUNKT ERREICHT IST
	POP	BC
	DEC	BC
	LD	SP,HL
	LD	HL,RAM.TLOC
	LD	A,(HL)
	SUB	C
	INC	HL
	JR	NZ,RSTA
	LD	A,(HL)
	SBC	A,B
	JR	Z,RST1		;HALTEPUNKT 1 ERREICHT
;TEST, OB HALTEPUNKT 2 ERREICHT WURDE
RSTA:	INC	HL
	INC	HL
	LD	A,(HL)
	SUB	C
	INC	HL
	JR	NZ,RSTB
	LD	A,(HL)
	SBC	A,B
	JR	Z,RST1		;HALTEPUNKT 2 ERREICHT
;KEIN HALTEPUNKT ERREICHT
RSTB:	INC	BC
;RETTEN VON HL
RST1:	LD	HL,RAM.LLOC
	LD	(HL),E
	INC	HL
	LD	(HL),D
; RETTEN VON PC
	LD	L,LOW(RAM.PLOC-1)
	LD	(HL),C
	INC	HL
	LD	(HL),B
;AUSGABE DER STOP-ADRESSE
	PUSH	BC
	CALL	COMC
	DB	'@'
	POP	HL
	CALL	LADR
;RESTAURIEREN DES SPEICHERINHALTES AN DEN HALTEPUNKTEN
;UND LOESCHEN DER TABELLE FUER DIE HALTEPUNKTE
	LD	HL,RAM.TLOC
	LD	D,2
RST2:	LD	C,(HL)
	XOR	A
	LD	(HL),A
	INC	HL
	LD	B,(HL)
	LD	(HL),A
	INC	HL
	LD	A,C
	OR	B
	JR	Z,RST3
	LD	A,(HL)
	LD	(BC),A
RST3:	INC	HL
	DEC	D
	JR	NZ,RST2
	JP	START
;*---*---*---*---*---*---*---*---*---*---*---*---*---*---*---*---*---*
;RUECKSPRUNGROUTINE ZUM STARTEN EINES ANWENDERPROGRAMMS
EXIT:	POP	DE
	POP	BC
	POP	AF
	POP	IX
	POP	IY
	EX	AF,AF'
	EXX
	POP	AF
	LD	I,A
	POP	HL
	POP	DE
	POP	BC
	POP	AF
	EXX
	EX	AF,AF'
	POP	HL
	LD	SP,HL
	JP	RAM.EXI1
;*---*---*---*---*---*---*---*---*---*---*---*---*---*---*---*---*---*
;SUBR. ZUM INKREMENTIEREN VON HL UND VERGLEICHEN MIT DE
;***IN: HL...1. OPERAND
;       DE...2. OPERAND
;**OUT: HL=HL+1
;       CARRY=0: HL<=DE
;       CARRY=1: HL>DE,HL=0
;*KILL: A,F,H,L
HILO:	INC	HL
	LD	A,H
	OR	L
	SCF
	RET	Z
	LD	A,E
	SUB	L
	LD	A,D
	SBC	A,H
	RET
;*---*---*---*---*---*---*---*---*---*---*---*---*---*---*---*---*---*
;SUBR. ZUR AUSGABE EINES ZEICHENS UEBER DAS GERAET "O"
;***IN: ZEICHEN AUF SPEICHERPLATZ HINTER CALL
;**OUT: C...ZEICHEN
;       (SP)=(SP)+1
;*KILL: A,F,C
POC:	EX	(SP),HL
	LD	C,(HL)
	INC	HL
	EX	(SP),HL
	JP	MWO
;*---*---*---*---*---*---*---*---*---*---*---*---*---*---*---*---*---*
;SUBR. ZUR KONVERTIERUNG EINES HALBBYTES IN EIN HEXADEZ. ASCII-ZEICHEN
;***IN: A...HALBBYTE
;**OUT: A,C...HEXADEZ. ASCII-ZEICHEN
;*KILL: A,F,C
CONV:	AND	0FH
	ADD	A,90H
	DAA
	ADC	A,40H
	DAA
	LD	C,A
	RET
;*---*---*---*---*---*---*---*---*---*---*---*---*---*---*---*---*---*
;SUBR. ZUR AUSGABE EINES REGISTERINHALTES UEBER DAS GERAET "L"
;***IN: HL...TABELLENPLATZ DES REGISTERS
;**OUT: HL=HL+3
;*KILL: A,F,B,C,D,E,H,L
LREG:	INC	HL
	LD	E,(HL)
	LD	D,HIGH(EOM)	;   EOM/256
	INC	HL
	LD	B,(HL)
	INC	HL
	LD	A,(DE)
	CALL	LBYTE
	DEC	B
	RET	M
	DEC	DE
	LD	A,(DE)
	JR	LBYTE
;*---*---*---*---*---*---*---*---*---*---*---*---*---*---*---*---*---*
;SUBR. ZUR AUSGABE VON 16 BIT BIN. INF. ALS ASCII-ZEICHEN
;UEBER DAS GERAET "L"
;***IN: HL...BIN. INF.
;**OUT: -
;*KILL: A,F,C
LADR:	LD	A,H
	CALL	LBYTE
	LD	A,L
;*---*---*---*---*---*---*---*---*---*---*---*---*---*---*---*---*---*
;SUBR. ZUR AUSGABE VON 8 BIT BIN. INF. ALS ASCII-ZEICHEN
;UEBER DAS GERAET "L"
;***IN: A...BIN. INF.
;**OUT: -
;*KILL: A,F,C
LBYTE:	PUSH	AF
	RRCA
	RRCA
	RRCA
	RRCA
	CALL	CONV
	CALL	MLO
	POP	AF
	CALL	CONV
	JP	MLO
;*---*---*---*---*---*---*---*---*---*---*---*---*---*---*---*---*---*
;SUBR. ZUR EINGABE VON HEXADEZ. PARAMETERN UEBER DAS TERMINAL
;***IN: C...ZAHL DER PARAMETER
;**OUT: PARAMETER IM STACK
;       SP=SP-2*C
;*KILL: A,F,B,C,H,L,SP
EXPR:	CALL	PARAM
	EX	(SP),HL
	PUSH	HL
	DEC	C
	JR	NC,EX0
	JR	NZ,ERR1
	RET
EX0:	JR	NZ,EXPR
ERR1:	JP	ERROR
;*---*---*---*---*---*---*---*---*---*---*---*---*---*---*---*---*---*
;SUBR. ZUR EINGABE VON 24 BIT BIN. INF. ALS HEXADEZ. ASCII-ZEICHEN
; UEBER DAS TERMINAL
;***IN: -
;**OUT: A,H,L...BIN. INF.
;       B...TRENNZEICHEN
;*KILL: A,F,B,H,L
PARAM:	CALL	PCHK
	JR	Z,ERR1
PA0:	PUSH	BC
	LD	HL,0
	LD	C,H
PA1:	LD	B,A
	CALL	NIBLE
	JR	C,PA2
	LD	B,A
	LD	A,C
	ADD	HL,HL
	RLA
	ADD	HL,HL
	RLA
	ADD	HL,HL
	RLA
	ADD	HL,HL
	RLA
	LD	C,A
	LD	A,B
	OR	L
	LD	L,A
	CALL	TI
	JR	PA1
PA2:	LD	A,B
	CALL	P2C
	JR	NZ,ERR1
	EX	(SP),HL
	LD	H,B
	EX	(SP),HL
	LD	A,C
	POP	BC
	RET
;*---*---*---*---*---*---*---*---*---*---*---*---*---*---*---*---*---*
;SUBR. ZUR KONVERTIERUNG VON 1 HEXAD. ASCII-Z. IN 1 HALBBYTE BIN. INF.
;***IN: A...HEXADEZ. ASCII-Z.
;**OUT: A...HALBBYTE
;       CARRY=1: FALSCHES ASCII-Z.
;*KILL: A,F
NIBLE:	SUB	'0'
	RET	C
	ADD	A,0E9H
	RET	C
	ADD	A,6
	JP	P,NI0
	ADD	A,7
	RET	C
NI0:	ADD	A,10
	OR	A
	RET
;*---*---*---*---*---*---*---*---*---*---*---*---*---*---*---*---*---*
;SUBR. ZUR EINGABE EINES ZEICHENS UEBER DAS TERMINAL
;UND TEST AUF ERLAUBTE TRENNZEICHEN
;***IN: -
;**OUT: A...EINGEGEBENES ZEICHEN
;       CARRY=1: EINGEG. Z. IST CR
;        ZERO=1: EINGEG. Z. IST LEERZ., KOMMA ODER CR
;*KILL: A,F,C
PCHK:	CALL	TI
;*---*---*---*---*---*---*---*---*---*---*---*---*---*---*---*---*---*
;SUBR. ZUM TEST AUF ERLAUBTE TRENNZEICHEN
;***IN: A...ZEICHEN
;**OUT: -
;       CARRY=1: EINGEG. Z. IST CR
;        ZERO=1: EINGEG. Z. IST LEERZ., KOMMA ODER CR
;*KILL: F
P2C:	CP	' '
	RET	Z
	CP	','
	RET	Z
	CP	0DH
	SCF
	RET	Z
	CCF
	RET
;*---*---*---*---*---*---*---*---*---*---*---*---*---*---*---*---*---*
;SUBR. ZUR EINGABE EINES BIN. BYTES UEBER DAS LOG. GERAET "I"
;UND ADDIEREN DES BYTES ZUM INHALT VON D
;***IN: -
;**OUT: A...EINGEGEBENES BYTE
;       D=D+A
;       FLAGS...ENTSPR. DEM ERGEBNIS DER ADD.
;*KILL: A,F,D
IBYTE:	PUSH	BC
	CALL	MRI
	CALL	NIBLE
	RLCA
	RLCA
	RLCA
	RLCA
	LD	C,A
	CALL	MRI
	CALL	NIBLE
	OR	C
	LD	C,A
	ADD	A,D
	LD	D,A
	LD	A,C
	POP	BC
	RET
;*---*---*---*---*---*---*---*---*---*---*---*---*---*---*---*---*---*
;SUBR. ZUR AUSGABE VON 16 BIT BIN. INF. ALS ASCII-Z. UEBER GERAET "O"
;***IN: HL...BIN. INF.
;**OUT: -
;*KILL: A,F,C
OADR:	LD	A,H
	CALL	OBYTE
	LD	A,L
;*---*---*---*---*---*---*---*---*---*---*---*---*---*---*---*---*---*
;SUBR. ZUR AUSGABE VON  8 BIT BIN. INF. ALS ASCII-Z. UEBER GERAET "O"
;***IN: A...BIN. INF.
;**OUT: -
;*KILL: A,F,C
OBYTE:	LD	E,A
	RRCA
	RRCA
	RRCA
	RRCA
	CALL	CONV
	CALL	MWO
	LD	A,E
	CALL	CONV
	CALL	MWO
	LD	A,E
	ADD	A,D
	LD	D,A
	RET
;*---*---*---*---*---*---*---*---*---*---*---*---*---*---*---*---*---*
;SUBR. ZUR AUSGABE VON CR UND LF AUF DEM GERAET "O"
;***IN: -
;**OUT: -
;*KILL: A,F,C
OCRLF:	CALL	POC
	DB	0DH
	CALL	POC
	DB	0AH
	RET
;*---*---*---*---*---*---*---*---*---*---*---*---*---*---*---*---*---*
;DISPLAY-KOMMANDO
DISP:	EQU	$
	CALL	EXPR
	POP	DE		;ENDADRESSE IN DE
	POP	HL		;ANFANGSADRESSE IN HL
;AUSGABE DER ADRESSE
DI0:	CALL	LCRLF
	CALL	LADR
;AUSGABE EINES LEERZEICHENS
DI1:	LD	C,' '
	CALL	LO
;AUSGABE EINES BYTES
	LD	A,(HL)
	CALL	LBYTE
;KOMMANDO-ENDE ?
	CALL	HILO
	JP	C,LCRLF
;ZEILENENDE ?
	LD	A,L
	AND	0FH
	JR	NZ,DI1
	JR	DI0
;*---*---*---*---*---*---*---*---*---*---*---*---*---*---*---*---*---*
;END-FILE KOMMANDO
EOF:	EQU	$
	DEC	C
	CALL	EXPR		;EINGABE DER STARTADRESSE
;AUSGABE VON ":"
	CALL	POC
	DB	':'
;AUSGABE DER REKORDLAENGE 0
	XOR	A
	LD	D,A
	CALL	OBYTE
;AUSGABE DER STARTADRESSE
	POP	HL
	CALL	OADR
;AUSGABE DES DATENTYPS
	LD	A,1
	CALL	OBYTE
;BERECHNUNG UND AUSGABE DER CHECKSUMME
	XOR	A
	SUB	D
	CALL	OBYTE
;*---*---*---*---*---*---*---*---*---*---*---*---*---*---*---*---*---*
;SUBR. ZUR AUSGABE VON 60 LEERSTELLEN AUF DEM GERAET "O"
;***IN: -
;**OUT: -
;*KILL: A,F,B,C
LEAD:	LD	B,60
LE0:	CALL	POC
	DB	0
	DJNZ	LE0
	RET
;*---*---*---*---*---*---*---*---*---*---*---*---*---*---*---*---*---*
;FILL-KOMMANDO
FILL:	EQU	$
	INC	C
	CALL	EXPR
	POP	BC		;KONSTANTE IN C
	POP	DE		;ENDADRESSE IN DE
	POP	HL		;ANFANGSADRESSE IN HL
FI0:	LD	(HL),C
	CALL	HILO
	JR	NC,FI0
	RET
;*---*---*---*---*---*---*---*---*---*---*---*---*---*---*---*---*---*
;GO-KOMMANDO
GOTO:	EQU	$
;VORBEREITEN DES SPRUNGES IN DAS ANWENDERPROGRAMM
	LD	HL,EXIT
	EX	(SP),HL
;STARTADRESSE ?
	CALL	PCHK
	JR	Z,GO0		;KEINE STARTADRESSE ANGEGEBEN
;EINGABE DER STARTADRESSE
	CALL	PA0
	EX	DE,HL
	LD	HL,RAM.PLOC
	LD	(HL),D
	DEC	HL
	LD	(HL),E
GO0:	JR	C,GO4		;KEINE HALTEPUNKTE ANGEGEBEN
	LD	DE,2
;EINGABE DES HALTEPUNKTES
GO1:	CALL	COMC
	DB	'-'
	CALL	PARAM
	PUSH	HL
	INC	D
	JR	C,GO2		;NUR EIN HALTEPUNKT
	DEC	E
	JR	NZ,GO1
	JP	NC,ERROR
GO2:	LD	HL,RAM.TLOC
;ADRESSE DER HALTEPUNKTE IN TABELLE
GO3:	POP	BC
	LD	(HL),C
	INC	HL
	LD	(HL),B
	INC	HL
;RETTEN DES SPEICHERINHALTES AM HALTEPUNKT
	LD	A,(BC)
	LD	(HL),A
	INC	HL
;SETZEN DES HALTEPUNKTES
	LD	A,0FFH		;RST 56
	LD	(BC),A
	DEC	D
	JR	NZ,GO3
GO4:	JP	CRLF		;SPRUNG IN ANWENDERPROGRAMM
;*---*---*---*---*---*---*---*---*---*---*---*---*---*---*---*---*---*
;ADDITION UND SUBTRAKTION VON HEXADEZIMALZAHLEN
HEXN:	EQU	$
	CALL	EXPR
	CALL	CRLF
	POP	DE		;2. OPERAND IN DE
	POP	HL		;1. OPERAND IN HL
	PUSH	HL
	ADD	HL,DE		;ADDITION
	CALL	LADR		;AUSGABE DER SUMME
	CALL	BLK
	POP	HL
	OR	A
	SBC	HL,DE		;SUBTRAKTION
	JP	LADR		;AUSGABE DER DIFFERENZ
;*---*---*---*---*---*---*---*---*---*---*---*---*---*---*---*---*---*
;MOVE-KOMMANDO
MOVE:	EQU	$
	INC	C
	CALL	EXPR
	POP	BC		;ADRESSE DES ZIELGEBIETES IN BC
	POP	DE		;ENDADRESSE DES QUELLGEB. IN DE
	POP	HL		;ANFANGSADRESSE DES QUELLGEB. IN HL
MV0:	LD	A,(HL)
	LD	(BC),A
	INC	BC
	CALL	ZS		;ERHOLZEIT PROG.-MONO
	CALL	HILO
	JR	NC,MV0
	RET
;*---*---*---*---*---*---*---*---*---*---*---*---*---*---*---*---*---*
;READ-KOMMANDO
READ:	EQU	$
	DEC	C
	CALL	EXPR		;EINGABE DES OFFSET
	CALL	CRLF
;WARTEN AUF EINGABE VON ":"
RED0:	CALL	MRI
	CP	':'
	JR	NZ,RED0
	XOR	A
	LD	D,A
	CALL	IBYTE		;EINGABE DER REKORDLAENGE
	JR	Z,RED3		;REKORDLAENGE = 0
	LD	E,A
;EINGABE DER REKORDADRESSE
	CALL	IBYTE
	LD	H,A
	CALL	IBYTE
	LD	L,A
;EINGABE DES DATENTYPS
	CALL	IBYTE
	LD	C,E
;EINGABE DER REKORDINFORMATION IN PUFFER
	PUSH	HL
	LD	HL,0FF00H
	ADD	HL,SP
RED1:	CALL	IBYTE
	LD	(HL),A
	INC	HL
	DEC	E
	JR	NZ,RED1
	CALL	IBYTE		;EINGABE DER CHECKSUMME
	JP	NZ,ERROR	;FALSCHE CHECKSUMME
;BERECHNUNG DER LADEADRESSE
	POP	DE
	EX	(SP),HL
	EX	DE,HL
	ADD	HL,DE
	LD	B,0
	ADD	HL,BC
	EX	DE,HL
	EX	(SP),HL
;LADEN DES GELESENEN REKORDS
RED2:	DEC	HL
	DEC	DE
	LDDR
	JR	RED0
;LADEN DER STARTADRESSE
RED3:	LD	HL,RAM.PLOC
	CALL	IBYTE
	LD	(HL),A
	DEC	HL
	CALL	IBYTE
	LD	(HL),A
	POP	HL
	RET
;*---*---*---*---*---*---*---*---*---*---*---*---*---*---*---*---*---*
;SUBSTITUTE-KOMMANDO
SUBS:	EQU	$
	CALL	PARAM		;EINGABE DER 1. ADRESSE (HL)
	RET	C
;ANZEIGE DES BYTES
SU0:	LD	A,(HL)
	CALL	LBYTE
	CALL	COMC
	DB	'-'
	CALL	PCHK
	RET	C		;ENDE DES KOMMANDOS (CR)
	JR	Z,SU1		;KEINE AENDERUNG DES INHALTES (LEERZ.)
;EINGABE DES NEUEN SPEICHERINHALTES
	EX	DE,HL
	CALL	PA0
	EX	DE,HL
	LD	(HL),E
	RET	C			;ENDE DES KOMMANDOS (CR)
SU1:	INC	HL
	JR	SU0
;*---*---*---*---*---*---*---*---*---*---*---*---*---*---*---*---*---*
;SPEICHERTEST
KNOW:	EQU	$
	CALL	EXPR
	LD	B,0
	POP	DE		;ENDEADR
ST1:	POP	HL		;ANF-ADR
	PUSH	HL
ST2:	LD	A,L		;FILL
	XOR	H
	XOR	B
	LD	(HL),A
	CALL	HILO
	JR	NC,ST2
	POP	HL
ST3:	LD	A,L
	XOR	H
	XOR	B
	CP	(HL)
	JR	NZ,V1
	CALL	HILO
	JR	NC,ST3
	RET
;*---*---*---*---*---*---*---*---*---*---*---*---*---*---*---*---*---*
;WRITE-KOMMANDO
WRITE:	EQU	$
	CALL	EXPR
	CALL	CRLF
	POP	DE		;ENDADRESSE IN DE
	POP	HL		;ANFANGSADRESSE IN HL
;AUSGABE VON ":"
WR0:	CALL	POC
	DB	':'
;BESTIMMEN DER REKORDLAENGE
	LD	BC,16
	PUSH	HL
WR1:	INC	B
	DEC	C
	JR	Z,WR2
	CALL	HILO
	JR	NC,WR1
WR2:	POP	HL
	PUSH	DE
	LD	D,0
	LD	A,B
	CALL	OBYTE		;AUSGABE DER REKORDLAENGE
	CALL	OADR		;AUSGABE DER REKORDADRESSE
;AUSGABE DES DATENTYPS
	XOR	A
	CALL	OBYTE
;AUSGABE DER REKORDINFORMATION
WR3:	LD	A,(HL)
	CALL	OBYTE
	INC	HL
	DJNZ	WR3
;BERECHNUNG UND AUSGABE DER CHECKSUMME
	XOR	A
	SUB	D
	CALL	OBYTE
	POP	DE
	DEC	HL
;AUSGABE VON CR,LF
	CALL	OCRLF
	CALL	HILO
	JR	NC,WR0
	RET
;*---*---*---*---*---*---*---*---*---*---*---*---*---*---*---*---*---*
;VERGLEICH VON SPEICHERINHALTEN
VER:	EQU	$
	INC	C
	CALL	EXPR
	POP	BC		;ZIEL
	POP	DE		;ENDE
	POP	HL		;START
V2:	LD	A,(BC)
	CP	(HL)
	JR	NZ,V1		;BEI FEHLER
	INC	BC
	CALL	HILO
	JR	NC,V2
	RET
V1:	CALL	CRLF
	CALL	LADR
	RET
;*---*---*---*---*---*---*---*---*---*---*---*---*---*---*---*---*---*
;X-KOMMANDO
X:	EQU	$
	LD	HL,ACTBL
	CALL	PCHK
	JR	C,X5		;AUSGABE ALLER REGISTER
;BESTIMMUNG DER AUSZUGEBENDEN REGISTER
	LD	C,NREGS
X0:	CP	(HL)
	JR	Z,MX1
	INC	HL
	INC	HL
	INC	HL
	DEC	C
	JR	NZ,X0
	JP	ERROR
MX1:	CALL	BLK
;AUSGABE DES AKTUELLEN REGISTERINHALTES
MX2:	CALL	LREG
	CALL	COMC
	DB	'-'
	CALL	PCHK
	RET	C		;ENDE DES KOMMANDOS (CR)
	JR	Z,X4		;ANZEIGE DES NAECHSTEN REG. (LEERZ.)
	PUSH	HL
	PUSH	BC
;EINGABE EINES NEUEN REGISTERINHALTES
	CALL	PA0
	LD	A,L
	LD	(DE),A
	POP	AF
	OR	A
	JP	M,X3		; 8 BIT-REGISTER
;16 BIT-REGISTER
	INC	DE
	LD	A,H
	LD	(DE),A
X3:	POP	HL
X4:	XOR	A
	OR	(HL)
	RET	M		;ALLE REGISTER ANGEZEIGT
	LD	A,B
	CP	0DH
	RET	Z			;ENDE DES KOMMANDOS
	JR	MX2
;ANZEIGE ALLER REGISTER
X5:	CALL	CRLF
X6:	CALL	BLK
	XOR	A
	OR	(HL)
	RET	M		;TABELLENENDE MINUS=FF
	LD	C,(HL)
	CALL	MCO		;AUSGABE DES REGISTER-NAMENS
	CALL	COMC
	DB	'='
	CALL	LREG		;AUSGABE DES REGISTER-INHALTES
	JR	X6
;TABELLE DER REGISTER-ADRESSEN
ACTBL:	DB	'A'
	DB	LOW(ALOC)
	DB	0
	DB	'B'
	DB	LOW(BLOC)
	DB	0
	DB	'C'
	DB	LOW(CLOC)
	DB	0
	DB	'D'
	DB	LOW(DLOC)
	DB	0
	DB	'E'
	DB	LOW(ELOC)
	DB	0
	DB	'F'
	DB	LOW(FLOC)
	DB	0
	DB	'H'
	DB	LOW(HLOC)
	DB	0
	DB	'L'
	DB	LOW(RAM.LLOC)
	DB	0
	DB	'M'
	DB	LOW(HLOC)
	DB	1
	DB	'P'
	DB	LOW(RAM.PLOC)
	DB	1
	DB	'S'
	DB	LOW(SLOC)
	DB	1
	DB	0FFH
NREGS	EQU	($-ACTBL)/3
;*---*---*---*---*---*---*---*---*---*---*---*---*---*---*---*---*---*
;Z-KOMMANDO
ZR:	EQU	$
	LD	HL,ZACTL
	CALL	PCHK
	JR	C,X5		;ANZEIGE ALLER REGISTER
	LD	C,ZREGS
	JP	X0
;TABELLE DER REGISTERADRESSEN
ZACTL:	DB	'A'
	DB	LOW(ASLC)
	DB	0
	DB	'B'
	DB	LOW(BSLC)
	DB	0
	DB	'C'
	DB	LOW(CSLC)
	DB	0
	DB	'D'
	DB	LOW(DSLC)
	DB	0
	DB	'E'
	DB	LOW(ESLC)
	DB	0
	DB	'F'
	DB	LOW(FSLC)
	DB	0
	DB	'H'
	DB	LOW(HSLC)
	DB	0
	DB	'L'
	DB	LOW(LSLC)
	DB	0
	DB	'I'
	DB	LOW(ILOC)
	DB	0
	DB	'X'
	DB	LOW(XLOC+1)
	DB	1
	DB	'Y'
	DB	LOW(YLOC+1)
	DB	1
	DB	0FFH
ZREGS	EQU	($-ZACTL)/3
	;END
